## Kconfig
```kconfig
menuconfig PAW3222
    bool "PAW3222 mouse optical sensor"
    select SPI
    help
      Enable PAW3222 mouse optical sensor.

if PAW3222

config PAW3222_RES_CPI
    int "PAW3222 default CPI"
    range 380 4826
    default 1200
    help
      Default CPI (counts per inch) resolution for the sensor.
      Hardware supports 608-4826 CPI (16*38 to 127*38).
      Values below 608 will be clamped to minimum hardware limit.

config PAW3222_SNIPE_CPI
    int "PAW3222 snipe mode CPI"
    range 380 4826
    default 400
    help
      CPI resolution for snipe (high-precision) mode.
      Hardware supports 608-4826 CPI (16*38 to 127*38).
      Values below 608 will be clamped to minimum hardware limit.
      Lower values provide higher precision.

config PAW3222_SCROLL_TICK
    int "Scroll tick threshold"
    range 1 255
    default 10
    help
      Threshold for scroll movement (delta value above which scroll is triggered).
      Higher values make scrolling less sensitive.

config PAW3222_SNIPE_DIVISOR
    int "Snipe mode sensitivity divisor"
    range 1 10
    default 2
    help
      Divisor for snipe mode sensitivity (higher values = lower sensitivity).
      In snipe mode, cursor movement is divided by this value for ultra-precision.
      Range: 1 (no reduction) to 10 (very low sensitivity).

config PAW3222_SCROLL_SNIPE_DIVISOR
    int "Scroll snipe mode sensitivity divisor"
    range 1 10
    default 3
    help
      Divisor for scroll snipe mode sensitivity (higher values = lower sensitivity).
      In scroll snipe mode, scroll movement is divided by this value for ultra-precision scrolling.
      Range: 1 (no reduction) to 10 (very low sensitivity).

config PAW3222_SCROLL_SNIPE_TICK
    int "Scroll snipe mode tick threshold"
    range 1 255
    default 20
    help
      Threshold for scroll movement in snipe mode (delta value above which scroll is triggered).
      Higher values make snipe scrolling less sensitive, allowing for more precise control.
      Should typically be higher than regular scroll-tick for finer control.

config PAW3222_SENSOR_ROTATION
    int
    default 0
    help
      Default sensor rotation angle in degrees.
      This value is used when rotation is not specified in device tree.
      Valid values are 0, 90, 180, or 270 degrees.

config PAW3222_BEHAVIOR
    bool "Enable PAW3222 behavior support"
    default n
    help
      Enable ZMK behavior support for PAW3222 mode switching.
      This allows using &paw_mode behavior in keymaps.

endif # PAW3222
```

## dts/bindings/behaviors/accel-toggle.yaml
```yaml
description: Toggle accel for paw3222
compatible: "zmk,behavior-accel-toggle"
include: base.yaml

properties:
  "#binding-cells":
    type: int
    required: true
    const: 1
```

## dts/bindings/behaviors/paw32xx_mode.yaml
```yaml
# Copyright 2025 nuovotaka
# SPDX-License-Identifier: Apache-2.0

description: PAW3222 input mode switching behavior

compatible: "paw32xx,mode"

include: one_param.yaml
```

## dts/bindings/pixart,paw3222.yaml
```yaml
# Copyright 2024 Google LLC
# Copyright 2025 sekigon-gonnoc
# Copyright 2025 nuovotaka
# SPDX-License-Identifier: Apache-2.0

description: PAW32xx ultra low power wireless mouse chip

compatible: "pixart,paw3222"

include: spi-device.yaml

properties:
  irq-gpios:
    type: phandle-array
    required: true
    description: GPIO connected to the motion pin, active low.

  power-gpios:
    type: phandle-array
    required: false
    description: GPIO connected to the power control pin.

  snipe-layers:
    type: array
    required: false
    description: |
      List of layer numbers to switch between using the snipe-layers feature.

  scroll-layers:
    type: array
    required: false
    description: |
      List of layer numbers to switch between using the scroll-layers feature.

  scroll-horizontal-layers:
    type: array
    required: false
    description: |
      List of layer numbers to switch between using the horizontal scroll feature.

  res-cpi:
    type: int
    description: |
      CPI resolution for the sensor. This can also be changed in runtime using
      the paw32xx_set_resolution() API.

  snipe-cpi:
    type: int
    required: false
    description: |
      CPI resolution for snipe (high-precision) mode. If not specified, 
      defaults to the value of CONFIG_PAW3222_SNIPE_CPI.

  snipe-divisor:
    type: int
    required: false
    description: |
      Additional precision divisor for snipe mode. Movement values are divided 
      by this factor in addition to CPI reduction. Higher values = more precision.
      If not specified, defaults to 2.

  force-awake:
    type: boolean
    description: |
      Initialize the sensor in "force awake" mode. This can also be enabled or
      disabled in runtime by the application using the paw32xx_force_awake()
      API.

  rotation:
    type: int
    required: false
    description: |
      Physical rotation of the sensor in degrees. (0, 90, 180, 270)
      Used for scroll direction mapping to ensure y-axis movement always triggers scroll.
      For cursor movement rotation, use ZMK input-processors like zip_xy_transform.
      If not specified, defaults to the value of CONFIG_PAW3222_SENSOR_ROTATION.

  scroll-tick:
    type: int
    required: false
    description: |
      Threshold for scroll movement (delta value above which scroll is triggered).
      If not specified, defaults to the value of CONFIG_PAW3222_SCROLL_TICK.

  scroll-snipe-layers:
    type: array
    required: false
    description: |
      List of layer numbers to switch between using the scroll-snipe-layers feature.
      Provides high-precision vertical scrolling.

  scroll-horizontal-snipe-layers:
    type: array
    required: false
    description: |
      List of layer numbers to switch between using the horizontal scroll-snipe feature.
      Provides high-precision horizontal scrolling.

  scroll-snipe-divisor:
    type: int
    required: false
    description: |
      Additional precision divisor for scroll snipe mode. Scroll movement values are divided 
      by this factor for ultra-precision scrolling. Higher values = more precision.
      If not specified, defaults to CONFIG_PAW3222_SCROLL_SNIPE_DIVISOR.

  scroll-snipe-tick:
    type: int
    required: false
    description: |
      Threshold for scroll movement in snipe mode (delta value above which scroll is triggered).
      Should typically be higher than regular scroll-tick for finer control.
      If not specified, defaults to CONFIG_PAW3222_SCROLL_SNIPE_TICK.

  switch-method:
    type: string
    required: false
    enum:
      - "layer"
      - "toggle"
      - "hold"
      - "combo"
    default: "layer"
    description: |
      Method for switching input modes:
      - "layer": Use ZMK layers (original method)
      - "toggle": Use toggle key behavior
      - "hold": Use hold key behavior
      - "combo": Use key combination

  use-cycle-modes:
    type: boolean
    required: false
    description: |
      If true, cycle through all available modes (move -> scroll -> horizontal -> snipe -> etc).
      If false, toggle between move and scroll modes only.
      Only applies when switch-method is "toggle".
```
